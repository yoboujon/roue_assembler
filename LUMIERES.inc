;**************************************
;     Les deux Barettes 	
;***************************************

;***************VARIABLES**************************************************
	 AREA  MesDonnees, data, readwrite
;**************************************************************************

isLedOn		DCB 0x00
SwitchState	DCB	0x00

Barette1 	DCB 0xff,0x00,0x0
			DCB 0xff,0x00,0x0
			DCB 0xff,0x00,0x0
			DCB 0xff,0x00,0x0
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			DCB 0x00,0x00,0x00
			
Barette2 	DCB 0x00,0x00,0x00
			DCB 0x00,0xff,0xff
			DCB 0x00,0xff,0xff
			DCB 0x00,0xff,0xff
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			DCB 0x00,0x00,0x00
			
			
TVI_Pile	EQU	0x20000200		;9 bits de poids faible = 0
			
	END
		